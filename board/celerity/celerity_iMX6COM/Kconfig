## board/celerity/celerity_iMX6COM/Kconfig
```kconfig
if TARGET_CELERITY_IMX6COM

config SYS_BOARD
	default "celerity_iMX6COM"

config SYS_VENDOR
	default "celerity"

config SYS_SOC
	default "mx6"

config SYS_CONFIG_NAME
	default "celerity_iMX6COM"

endif
```

## board/celerity/imx6com/Kconfig
```kconfig
if TARGET_IMX6COM

config SYS_BOARD
	default "imx6com"

config SYS_VENDOR
	default "celerity"

config SYS_SOC
	default "mx6"

config SYS_CONFIG_NAME
	default "imx6com"

endif
```

## board/google/loonswitch/Kconfig
```kconfig
if TARGET_LOONSWITCH

config SYS_BOARD
	default "loonswitch"

config SYS_VENDOR
	default "google"

config SYS_SOC
	default "mx6"

config SYS_CONFIG_NAME
	default "loonswitch"

endif
```

## configs/celerity_iMX6COM_defconfig
```kconfig
CONFIG_SYS_EXTRA_OPTIONS="IMX_CONFIG=board/celerity/celerity_iMX6COM/celerity_iMX6qCOM2g.cfg,MX6Q,DDR_MB=2048"
CONFIG_ARM=y
CONFIG_TARGET_CELERITY_IMX6COM=y
```

## configs/imx6com_defconfig
```kconfig
CONFIG_SYS_EXTRA_OPTIONS="IMX_CONFIG=board/celerity/imx6com/imx6com_2g.cfg,MX6Q,DDR_MB=2048"
CONFIG_ARM=y
CONFIG_TARGET_IMX6COM=y
```

## configs/loonswitch_defconfig
```kconfig
CONFIG_SYS_EXTRA_OPTIONS="IMX_CONFIG=board/google/loonswitch/loonswitch.cfg,MX6Q,DDR_MB=2048"
CONFIG_ARM=y
CONFIG_ARCH_MX6=y
CONFIG_TARGET_LOONSWITCH=y
```
